## arch/arm/configs/anycloud_ak3918ev300l_openipc_defconfig
```kconfig
CONFIG_ARM=y
CONFIG_ARCH_AK=y
CONFIG_MACH_AK3918EV300L=y
CONFIG_LOCALVERSION="-ak3918ev300l"
# CONFIG_LOCALVERSION_AUTO is not set
CONFIG_GPIOLIB=y
CONFIG_OF_GPIO=y
CONFIG_PINCTRL_AK=y
CONFIG_DEVTMPFS=y
CONFIG_DEVTMPFS_MOUNT=y
CONFIG_BLK_DEV_INITRD=y
CONFIG_RD_GZIP=y
CONFIG_BLK_DEV_RAM=y
CONFIG_BLK_DEV_RAM_SIZE=32768
CONFIG_TMPFS=y
CONFIG_OVERLAY_FS=y
CONFIG_SQUASHFS=y
CONFIG_SQUASHFS_XZ=y
CONFIG_MMC=y
CONFIG_MMC_BLOCK=y
CONFIG_PRINTK_TIME=y
CONFIG_MAGIC_SYSRQ=y
CONFIG_CMDLINE=""
# CONFIG_ARM_APPENDED_DTB is not set
CONFIG_SERIAL_AK_UART=y
CONFIG_SERIAL_AK_CONSOLE=y
```
